## config/boards/shields/chocolate/Kconfig.defconfig
```kconfig
config ZMK_BLE
	default y

config ZMK_USB
	default y

if SHIELD_CHOCOLATE_LEFT

config ZMK_SPLIT_BLE_ROLE_CENTRAL
	default y

endif # SHIELD_CHOCOLATE_LEFT

if SHIELD_CHOCOLATE_LEFT || SHIELD_CHOCOLATE_RIGHT

config ZMK_KEYBOARD_NAME
	default "_chocolate"

config ZMK_SPLIT
	default y

endif # SHIELD_CHOCOLATE_LEFT || SHIELD_CHOCOLATE_RIGHT
```

## config/boards/shields/chocolate/Kconfig.shield
```kconfig
config SHIELD_CHOCOLATE_LEFT
	def_bool $(shields_list_contains,chocolate_left)

config SHIELD_CHOCOLATE_RIGHT
	def_bool $(shields_list_contains,chocolate_right)
```
